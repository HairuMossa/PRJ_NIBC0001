VERSION ""

NS_ :

BS_:

BU_: NIBC
VAL_TABLE_ VT_SystemState 2 "ERROR" 1 "RUNNING" 0 " IDLE" ;

BO_ 3221225472 VECTOR__INDEPENDENT_SIG_MSG: 0 Vector__XXX
 SG_ Status_Res : 0|2@1+ (1,0) [0|0] "" Vector__XXX
 SG_ Error_Reserved : 0|8@1+ (1,0) [0|1] "" Vector__XXX
 SG_ Error_ADCFailure : 0|1@1+ (1,0) [0|1] "" Vector__XXX
 SG_ Error_OverTemp : 0|1@1+ (1,0) [0|1] "" Vector__XXX
 SG_ Error_OverCurrent : 0|1@1+ (1,0) [0|1] "" Vector__XXX
 SG_ SystemState : 0|2@1+ (1,0) [0|3] "" Vector__XXX
 SG_ Temp : 0|8@1- (1,0) [-45|125] "degC" Vector__XXX
 SG_ Iout : 0|8@1+ (0.05,0) [0|12] "A" Vector__XXX
 SG_ Vout : 0|8@1+ (0.2,0) [0|30] "V" Vector__XXX
 SG_ Iin : 0|8@1+ (0.1,0) [0|20] "A" Vector__XXX
 SG_ Vin : 0|8@1+ (0.25,0) [0|60] "V" Vector__XXX

BO_ 1365 TELEMETRY_1: 8 NIBC

CM_ BO_ 3221225472 "This is a message for not used signals, created by Vector CANdb++ DBC OLE DB Provider.";
VAL_ 3221225472 SystemState 2 "ERROR" 1 "RUNNING" 0 " IDLE" ;
